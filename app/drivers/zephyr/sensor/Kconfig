## app/drivers/zephyr/sensor/Kconfig
```kconfig
if SENSOR

menu "Sensor Drivers"
rsource "my_sensor/Kconfig"
endmenu

endif # SENSOR
```

## app/drivers/zephyr/sensor/my_sensor/Kconfig
```kconfig
config MY_SENSOR
	bool "My sensor"
	depends on (GPIO && I2C)
	help
	  Enable driver for my sensor.

config MY_SENSOR_SAMPLING_RATE
	int "Output data rate"
	default 1
	depends on MY_SENSOR
	help
	  Sensor output data rate expressed in samples per second.
	  Data rates supported by the chip are 1, 7, 13, 25.
```

## boards/arm/my_board/Kconfig.board
```kconfig
# MY BOARD board configuration

# Copyright (c) 2016 Open-RnD Sp. z o.o.
# SPDX-License-Identifier: Apache-2.0

config BOARD_MY_BOARD
	bool "MY BOARD Development Board"
	depends on SOC_STM32F103XB
```

## boards/arm/my_board/Kconfig.defconfig
```kconfig
# MY BOARD board configuration

# Copyright (c) 2016 Open-RnD Sp. z o.o.
# SPDX-License-Identifier: Apache-2.0

if BOARD_MY_BOARD

config BOARD
	default "my_board"

endif # BOARD_MY_BOARD
```

## boards/arm/my_board/dts/bindings/bourns,b104.yaml
```yaml
description: B104 potentiometer

compatible: "bourns,b104"

properties:
    io-channels:
      required: true
      type: phandle-array
      description: Potentiometer pin
```

## boards/arm/my_board/dts/bindings/sensor/st,my-sensor-press.yaml
```yaml
description: My pressure sensor

compatible: "st,my-sensor-press"

include: i2c-device.yaml

properties:
    irq-gpios:
      required: true
      type: phandle-array
      description: DRDY pin

        This pin defaults to active high when produced by the sensor.
        The property value should ensure the flags properly describe
        the signal that is presented to the driver.
```
