## CMakeLists.txt
```
cmake_minimum_required(VERSION 3.20.0)

list(APPEND ZEPHYR_EXTRA_MODULES ${CMAKE_CURRENT_SOURCE_DIR}/drivers)
list(APPEND ZEPHYR_EXTRA_MODULES ${CMAKE_CURRENT_SOURCE_DIR}/my_driver)

find_package(Zephyr REQUIRED HINTS $ENV{ZEPHYR_BASE})
project(my_zephyr_project)

target_sources(app 	PRIVATE src/main.c
			PRIVATE src/my_thread.c)
```

## prj.conf
```kconfig
CONFIG_MY_DRIVER=y
CONFIG_APPLICATION_DEFINED_SYSCALL=y
CONFIG_I2C=y
CONFIG_SENSOR=y
CONFIG_MY_SENSOR=y
CONFIG_MY_SENSOR_SAMPLING_RATE=1
CONFIG_ADC=y
CONFIG_LOG=y
CONFIG_LOG_OVERRIDE_LEVEL=3
```

## src/main.c
```c
#include <zephyr/kernel.h>
#include <zephyr/sys/printk.h>
#include <zephyr/drivers/sensor.h>
#include "my_driver.h"


/* -------------------- FIFO -------------------- */
typedef struct my_fifo_data {
	struct sensor_value press;
} my_data_t;

static my_data_t my_data;

K_FIFO_DEFINE(my_fifo);


/* -------------------- my_sensor_trigger_handler -------------------- */
static void my_sensor_trigger_handler(const struct device *dev, const struct sensor_trigger *trig)
{
	// Sensor test (producer)
	if ( sensor_sample_fetch(dev) < 0 ) {
		printk("LPS25HB sensor sample fetch error\n");
		return;
	}
	
	sensor_channel_get(dev, SENSOR_CHAN_PRESS, &(my_data.press));
	
	k_fifo_put(&my_fifo, &my_data);
}


/* -------------------- main [NOTA : more relevant in an application that would only requires a single thread] -------------------- */
int main(void)
{	
	const struct device *dev = device_get_binding("MY_DEVICE");
	
	const struct device *lps25hb = DEVICE_DT_GET(DT_NODELABEL(my_sensor));
	struct sensor_trigger trig = {0};
	
	my_data_t *p_my_data = NULL;
	
	printk("Test with board %s\n", CONFIG_BOARD);
	
	// Driver test
	if ( !device_is_ready(dev) ) {
		printk("Could not get MY_DEVICE\n");
		return -1;
	}
	
	printk("my_driver_do_this (%d)\n", my_driver_do_this(dev, 2, 3));
	my_driver_do_that(dev, NULL);
	
	// Sensor test (consumer)
	trig.type = SENSOR_TRIG_DATA_READY;
	trig.chan = SENSOR_CHAN_PRESS;
	sensor_trigger_set(lps25hb, &trig, my_sensor_trigger_handler); /* [NOTA] Handler will be called from a thread, so I2C or SPI operations are safe */
	
	while (1) {
		p_my_data = k_fifo_get(&my_fifo, K_FOREVER);
		printk("pressure = %d | %d\n", p_my_data->press.val1, p_my_data->press.val2);
	}
	
	return -1;
}
```

## src/my_thread.c
```c
#include <zephyr/kernel.h>
#include <zephyr/sys/printk.h>
#include <zephyr/drivers/gpio.h>
#include <zephyr/drivers/adc.h>


#define POTENTIOMETER_NODE	potentiometer
#define ADC_NODE		DT_PHANDLE(DT_PATH(POTENTIOMETER_NODE), io_channels)


void my_tread(void)
{
	/* [NOTA] 'gpios' property (index 0) from 'green_led_2' node (which alias is 'led0') */
	const struct gpio_dt_spec led = GPIO_DT_SPEC_GET_BY_IDX(DT_ALIAS(led0), gpios, 0);
	
	int16_t sample_val = 0;
	
	struct adc_channel_cfg channel_cfg = {
		.gain             = ADC_GAIN_1,
		.reference        = ADC_REF_INTERNAL,
		.acquisition_time = ADC_ACQ_TIME_DEFAULT,
		.channel_id       = DT_IO_CHANNELS_INPUT_BY_IDX(DT_PATH(POTENTIOMETER_NODE), 0),
		.differential     = 0
	};

	struct adc_sequence sequence = {
		.channels    = BIT(channel_cfg.channel_id),
		.buffer      = &sample_val,
		.buffer_size = sizeof(sample_val), //< buffer size in bytes, not number of samples
		.resolution  = 12,
	};
	
	const struct device *adc = DEVICE_DT_GET(ADC_NODE);
	
	int err = 0;
	
	printk("Starting my_thread\n");
	
	// LED test
	if ( !device_is_ready(led.port) ) {
		printk("Could not get LED\n");
		return;
	}
	
	gpio_pin_configure_dt(&led, GPIO_OUTPUT_ACTIVE);
	
	// ADC test
	if ( !device_is_ready(adc) ) {
		printk("Could not get ADC\n");
		return;
	}
	
	adc_channel_setup(adc, &channel_cfg);
	
	while (1) {
		err = adc_read(adc, &sequence);
		if (err != 0) {
			printk("ADC reading failed with error %d\n", err);
			return;
		}
		
		printk("ADC sample = %d\n", sample_val);
		
		gpio_pin_toggle_dt(&led);
		
		k_msleep(250);
	}
}

K_THREAD_DEFINE(my_tread_id, 1024, my_tread, NULL, NULL, NULL, 7, 0, 0);
```
